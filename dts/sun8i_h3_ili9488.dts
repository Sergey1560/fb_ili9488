/dts-v1/;
/plugin/;

/ {
        compatible = "allwinner,sun8i-h3";


        fragment@0 {
                target = <&spi0>;
                __overlay__ {
                        num-cs = <1>;
                        #address-cells = <1>;
                        #size-cells = <0>;
                        status = "okay";
		        cs-gpios = <&pio 2 3 0>;			

                        ili9488: ili9488@0 {
                                compatible = "ilitek,ili9488";
                                reg = <0>;
                                spi-max-frequency = <4000000>;
                                reset-gpios = <&pio 6 8 0>;
                                dc-gpios = <&pio 6 9 0>;
                                write-only;
                                buswidth = <8>;
                                rotation = <0>;
                        };
                };

        };
};