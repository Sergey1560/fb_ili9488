/dts-v1/;
/plugin/;

/ {
        compatible = "rockchip,rk3566";


        fragment@0 {
                target = <&spi3>;
                __overlay__ {
                        num-cs = <1>;
                        #address-cells = <1>;
                        #size-cells = <0>;
                        status = "okay";
                        ili9486: ili9486@0 {
                                compatible = "ilitek,ili9486";
                                reg = <0>;
                                spi-max-frequency = <4000000>;
                                reset-gpios = <&gpio4 7 1>;
                                dc-gpios = <&gpio4 4 0>;
                                write-only;
                                buswidth = <8>;
                                rotate = <0>;
                        };
                };

        };
};